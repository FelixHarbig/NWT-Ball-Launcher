## camera/sdkconfig.defaults
```kconfig
# ESP32-CAM (AI-Thinker) specific configuration

# gpt stuff
CONFIG_ESPTOOLPY_FLASHSIZE="4MB"
CONFIG_ESP32_DEFAULT_CPU_FREQ_160=y
CONFIG_ESP32_SPIRAM_SUPPORT=y
CONFIG_SPIRAM_SIZE=8192
CONFIG_SPIRAM_TYPE_AUTO=y
CONFIG_SPIRAM_USE_MALLOC=y
CONFIG_SPIRAM_USE_CAPS_ALLOC=y


# Enable PSRAM
CONFIG_SPIRAM_SUPPORT=y
CONFIG_SPIRAM_BOOT_INIT=y
CONFIG_SPIRAM_USE_CAPS_ALLOC=y
CONFIG_SPIRAM_MEMTEST=y
CONFIG_SPIRAM_TYPE_AUTO=y
CONFIG_SPIRAM_SIZE=-1

# TensorFlow Lite Micro
CONFIG_SPIRAM_ALLOW_BSS_SEG_EXTERNAL_MEMORY=y

# Wi-Fi
CONFIG_ESP_WIFI_ENABLED=y
CONFIG_ESP_WIFI_SOFTAP_SUPPORT=y

# HTTP Server
CONFIG_ESP_HTTP_SERVER_SUPPORT=y

# Camera
CONFIG_CAMERA_SUPPORT=y
CONFIG_CAMERA_MODULE_NAME="AI-THINKER"
CONFIG_CAMERA_PIN_PWDN=-1
CONFIG_CAMERA_PIN_RESET=-1
CONFIG_CAMERA_PIN_XCLK=0
CONFIG_CAMERA_PIN_SIOD=26
CONFIG_CAMERA_PIN_SIOC=27
CONFIG_CAMERA_PIN_D7=35
CONFIG_CAMERA_PIN_D6=34
CONFIG_CAMERA_PIN_D5=39
CONFIG_CAMERA_PIN_D4=36
CONFIG_CAMERA_PIN_D3=21
CONFIG_CAMERA_PIN_D2=19
CONFIG_CAMERA_PIN_D1=18
CONFIG_CAMERA_PIN_D0=5
CONFIG_CAMERA_PIN_VSYNC=25
CONFIG_CAMERA_PIN_HREF=23
CONFIG_CAMERA_PIN_PCLK=22

# Higher stack size for tasks
CONFIG_ESP_MAIN_TASK_STACK_SIZE=8192
CONFIG_FREERTOS_TIMER_TASK_STACK_DEPTH=4096

# Other settings
CONFIG_LOG_DEFAULT_LEVEL_INFO=y
CONFIG_LOG_MAXIMUM_LEVEL=4
CONFIG_PARTITION_TABLE_CUSTOM=y
CONFIG_PARTITION_TABLE_CUSTOM_FILENAME="partitions.csv"
```
